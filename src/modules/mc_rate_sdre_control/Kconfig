## src/modules/mc_rate_sdre_control/Kconfig
```kconfig
menuconfig MODULES_MC_RATE_SDRE_CONTROL
	bool "mc_rate_sdre_control"
	default n
	---help---
		Enable support for mc_rate_sdre_control

menuconfig USER_MC_RATE_SDRE_CONTROL
	bool "mc_rate_sdre_control running as userspace module"
	default n
	depends on BOARD_PROTECTED && MODULES_MC_RATE_SDRE_CONTROL
	---help---
		Put mc_rate_sdre_control in userspace memory
```

## src/modules/mc_sdre_control/Kconfig
```kconfig
menuconfig MODULES_MC_SDRE_CONTROL
	bool "mc_sdre_control"
	default n
	---help---
		Enable support for mc_sdre_control
```
